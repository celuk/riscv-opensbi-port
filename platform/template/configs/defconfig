## platform/template/configs/defconfig
```kconfig
CONFIG_SBI_ECALL_PMU=n
CONFIG_SBI_ECALL_DBTR=n
CONFIG_SBI_ECALL_CPPC=n
CONFIG_SBI_ECALL_SSE=n
CONFIG_SBI_ECALL_FWFT=n
CONFIG_SBI_ECALL_DBCN=y
CONFIG_SBI_ECALL_MPXY=n
CONFIG_SBI_ECALL_HSM=n
CONFIG_SBI_ECALL_RFENCE=n
CONFIG_FDT_HSM=n
CONFIG_FDT_HSM_RPMI=n
CONFIG_SBI_ECALL_SRST=n
CONFIG_SBI_ECALL_SUSP=n
```
